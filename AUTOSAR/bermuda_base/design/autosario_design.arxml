AUTOSAR XML (schema 00049)
package /UnsetARElements
  std cpp implementation data type Arithmetic: compu {0x00=kAdd, 0x01=kSub, 0x02=kMul, 0x03=kDiv}, type-reference=uint8_t
    namespaces:
      symbol props deepracer
      symbol props type
  std cpp implementation data type ByteArray: category=ARRAY, array-size=10, cpp-template-argument=uint8_t
    namespaces:
      symbol props deepracer
      symbol props type
  system DeepRacer: category=MACHINE_DESIGN_EXTRACT, system-version=1.0.0
  system DeepRacer: category=MACHINE_DESIGN_EXTRACT, system-version=1.0.0
  system DeepRacer: category=MACHINE_DESIGN_EXTRACT, system-version=1.0.0
  mode declaration group DeepRacerState: initial-mode=DeepRacerState/Off
    4 x mode:
      Device
      Off
      Simulation
      Verify
  mode declaration group DeepRacerState: initial-mode=DeepRacerState/Off
    4 x mode:
      Device
      Off
      Simulation
      Verify
  mode declaration group DeepRacerState: initial-mode=DeepRacerState/Off
    4 x mode:
      Device
      Off
      Simulation
      Verify
  std cpp implementation data type DistanceMap: category=ASSOCIATIVE_MAP, template-arguments=[Message, double]
    namespaces:
      symbol props deepracer
      symbol props type
  machine design Ecu: service-discover-configs=someip-service-discovery={multicast-sd-ip-address=PhysicalChannel/SdEndpoint, someip-service-discovery-port=30490}
    user defined communication connector IPC
    ethernet communication connector ens5: unicast-network-endpoint=PhysicalChannel/EcuEndpont
  machine design Ecu: service-discover-configs=someip-service-discovery={multicast-sd-ip-address=PhysicalChannel/SdEndpoint, someip-service-discovery-port=30490}
    user defined communication connector IPC
    ethernet communication connector ens5: unicast-network-endpoint=PhysicalChannel/EcuEndpont
  machine design Ecu: service-discover-configs=someip-service-discovery={multicast-sd-ip-address=PhysicalChannel/SdEndpoint, someip-service-discovery-port=30490}
    user defined communication connector IPC
    ethernet communication connector ens5: unicast-network-endpoint=PhysicalChannel/EcuEndpont
  ethernet cluster EthernetCluster
    ethernet physical channel PhysicalChannel: category=WIRED, comm-connectors=Ecu/ens5
      network endpoint EcuEndpont: network-endpoint-addresses=ipv-4-configuration={ipv-4-address=172.31.16.137, ipv-4-address-source=FIXED}
      network endpoint SdEndpoint: network-endpoint-addresses=ipv-4-configuration={ipv-4-address=224.0.0.1, ipv-4-address-source=FIXED}
  ethernet cluster EthernetCluster
    ethernet physical channel PhysicalChannel: category=WIRED, comm-connectors=Ecu/ens5
      network endpoint EcuEndpont: network-endpoint-addresses=ipv-4-configuration={ipv-4-address=172.31.16.137, ipv-4-address-source=FIXED}
      network endpoint SdEndpoint: network-endpoint-addresses=ipv-4-configuration={ipv-4-address=224.0.0.1, ipv-4-address-source=FIXED}
  ethernet cluster EthernetCluster
    ethernet physical channel PhysicalChannel: category=WIRED, comm-connectors=Ecu/ens5
      network endpoint EcuEndpont: network-endpoint-addresses=ipv-4-configuration={ipv-4-address=172.31.16.137, ipv-4-address-source=FIXED}
      network endpoint SdEndpoint: network-endpoint-addresses=ipv-4-configuration={ipv-4-address=224.0.0.1, ipv-4-address-source=FIXED}
  function group set FunctionGroupSet
    function-groups:
      mode declaration group prototype DeepRacerFG: type=UnsetARElements/DeepRacerState
      mode declaration group prototype MachineFG: type=UnsetARElements/MachineState
  function group set FunctionGroupSet
    function-groups:
      mode declaration group prototype DeepRacerFG: type=UnsetARElements/DeepRacerState
      mode declaration group prototype MachineFG: type=UnsetARElements/MachineState
  function group set FunctionGroupSet
    function-groups:
      mode declaration group prototype DeepRacerFG: type=UnsetARElements/DeepRacerState
      mode declaration group prototype MachineFG: type=UnsetARElements/MachineState
  machine Machine: machine-design=UnsetARElements/Ecu, trusted-platform-executable-launch-behavior=NO-TRUSTED-PLATFORM-SUPPORT
    module-instantiations:
      log and trace instantiation LogAndTraceInstantiation
      os module instantiation OsModuleInstantiation
        resource group ResourceGroup
    processor Core
      processor core Core: core-id=0
  machine Machine: machine-design=UnsetARElements/Ecu, trusted-platform-executable-launch-behavior=NO-TRUSTED-PLATFORM-SUPPORT
    module-instantiations:
      log and trace instantiation LogAndTraceInstantiation
      os module instantiation OsModuleInstantiation
        resource group ResourceGroup
    processor Core
      processor core Core: core-id=0
  machine Machine: machine-design=UnsetARElements/Ecu, trusted-platform-executable-launch-behavior=NO-TRUSTED-PLATFORM-SUPPORT
    module-instantiations:
      log and trace instantiation LogAndTraceInstantiation
      os module instantiation OsModuleInstantiation
        resource group ResourceGroup
    processor Core
      processor core Core: core-id=0
  mode declaration group MachineState: initial-mode=MachineState/Off
    5 x mode:
      Off
      Restart
      Shutdown
      Startup
      Verify
  mode declaration group MachineState: initial-mode=MachineState/Off
    5 x mode:
      Off
      Restart
      Shutdown
      Startup
      Verify
  mode declaration group MachineState: initial-mode=MachineState/Off
    5 x mode:
      Off
      Restart
      Shutdown
      Startup
      Verify
  std cpp implementation data type Message: category=STRING
    namespaces:
      symbol props deepracer
      symbol props type
  mode declaration group ProcessState: initial-mode=ProcessState/Idle
    4 x mode:
      Idle
      Running
      Starting
      Terminated
  mode declaration group ProcessState: initial-mode=ProcessState/Idle
    4 x mode:
      Idle
      Running
      Starting
      Terminated
  mode declaration group ProcessState: initial-mode=ProcessState/Idle
    4 x mode:
      Idle
      Running
      Starting
      Terminated
  14 x std cpp implementation data type:
    Speed: type-reference=double
      namespaces:
        symbol props deepracer
        symbol props type
    Uint32Vector: category=VECTOR, cpp-template-argument=uint32_t
      namespaces:
        symbol props deepracer
        symbol props type
    UserRecord: category=STRUCTURE
      namespaces:
        symbol props deepracer
        symbol props type
      cpp implementation data type element id: type-reference=uint32_t
      cpp implementation data type element age: type-reference=uint16_t
      cpp implementation data type element description: type-reference=Message
    bool: category=VALUE, type-emitter=FundamentalType
    double: category=VALUE, type-emitter=FundamentalType
    float: category=VALUE, type-emitter=FundamentalType
    int16_t: category=VALUE, header-file=cstdint
    int32_t: category=VALUE, header-file=cstdint
    int64_t: category=VALUE, header-file=cstdint
    int8_t: category=VALUE, header-file=cstdint
    uint16_t: category=VALUE, header-file=cstdint
    uint32_t: category=VALUE, header-file=cstdint
    uint64_t: category=VALUE, header-file=cstdint
    uint8_t: category=VALUE, header-file=cstdint
