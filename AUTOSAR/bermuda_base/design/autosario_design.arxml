AUTOSAR XML (schema 00049)
package /UnsetARElements
  system DeepRacer: category=MACHINE_DESIGN_EXTRACT, system-version=1.0.0
  mode declaration group DeepRacerState: initial-mode=DeepRacerState/Off
    4 x mode:
      Device
      Off
      Simulation
      Verify
  machine design Ecu: service-discover-configs=someip-service-discovery={multicast-sd-ip-address=SdEndpoint, someip-service-discovery-port=30490}
    user defined communication connector IPC
    ethernet communication connector ens5: unicast-network-endpoint=EcuEndpont
  ethernet cluster EthernetCluster
    ethernet physical channel PhysicalChannel: category=WIRED, comm-connectors=ens5
      network endpoint EcuEndpont: network-endpoint-addresses=ipv-4-configuration={ipv-4-address=172.31.16.137, ipv-4-address-source=FIXED}
      network endpoint SdEndpoint: network-endpoint-addresses=ipv-4-configuration={ipv-4-address=224.0.0.1, ipv-4-address-source=FIXED}
  function group set FunctionGroupSet
    function-groups:
      mode declaration group prototype DeepRacerFG: type=DeepRacerState
      mode declaration group prototype MachineFG: type=MachineState
  machine Machine: machine-design=Ecu, trusted-platform-executable-launch-behavior=NO-TRUSTED-PLATFORM-SUPPORT
    module-instantiations:
      log and trace instantiation LogAndTraceInstantiation
      os module instantiation OsModuleInstantiation
        resource group ResourceGroup
    processor Core
      processor core Core: core-id=0
  mode declaration group MachineState: initial-mode=MachineState/Off
    5 x mode:
      Off
      Restart
      Shutdown
      Startup
      Verify
  mode declaration group ProcessState: initial-mode=Idle
    4 x mode:
      Idle
      Running
      Starting
      Terminated
