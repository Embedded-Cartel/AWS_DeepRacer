AUTOSAR XML (schema 00049)
package /System
  system DeepRacerVehicle: category=MACHINE_DESIGN_EXTRACT, system-version=1.0.0
package /System/Service/Deployment
  someip service interface deployment SvControlData: service-interface=SvControlData, service-interface-id=82, service-interface-version={major-version=1, minor-version=0}
    someip event deployment CEvent: event=CEvent, event-id=1, transport-protocol=UDP
    someip event group Eventgroup_CEvent: event-group-id=1, event=CEvent
  someip service interface deployment SvRawData: service-interface=SvRawData, service-interface-id=81, service-interface-version={major-version=1, minor-version=0}
    someip event deployment REvent: event=REvent, event-id=1, transport-protocol=UDP
    someip field deployment RField: field=RField
      get Get_RField: method-id=2, transport-protocol=UDP
      notifier Notification_RField: event-id=2, transport-protocol=UDP
      set Set_RField: method-id=3, transport-protocol=UDP
    someip method deployment RMethod: method=RMethod, method-id=1, transport-protocol=UDP
    someip event group Eventgroup_Notification_RField: event-group-id=2, event=Notification_RField
    someip event group Eventgroup_REvent: event-group-id=1, event=REvent
package /System/VehicleTopology/Cluster
  ethernet cluster EthernetCluster
    ethernet physical channel PhysicalChannel: category=WIRED, comm-connectors=ens5
      network endpoint EcuEndpoint: network-endpoint-addresses=ipv-4-configuration={ipv-4-address=172.31.16.137, ipv-4-address-source=FIXED}
      network endpoint SdEndpoint: network-endpoint-addresses=ipv-4-configuration={ipv-4-address=224.0.0.1, ipv-4-address-source=FIXED}
package /System/VehicleTopology/Ecu
  machine design Ecu: service-discover-configs=someip-service-discovery={multicast-sd-ip-address=SdEndpoint, someip-service-discovery-port=30490}
    user defined communication connector IPC
    ethernet communication connector ens5: unicast-network-endpoint=EcuEndpoint
package /StateMachine
  mode declaration group DeepRacerState: initial-mode=DeepRacerState/Off
    4 x mode:
      Device
      Off
      Simulation
      Verify
  mode declaration group MachineState: initial-mode=MachineState/Off
    5 x mode:
      Off
      Restart
      Shutdown
      Startup
      Verify
  mode declaration group ProcessState: initial-mode=Idle
    4 x mode:
      Idle
      Running
      Starting
      Terminated
package /Platform
  machine Machine: machine-design=Ecu, trusted-platform-executable-launch-behavior=NO-TRUSTED-PLATFORM-SUPPORT
    module-instantiations:
      log and trace instantiation LogAndTraceInstantiation
      os module instantiation OsModuleInstantiation
        resource group ResourceGroup
    processor Core
      processor core Core0: core-id=0
package /Platform/FunctionGroup
  function group set FunctionGroupSet
    function-groups:
      mode declaration group prototype DeepRacerFG: type=DeepRacerState
      mode declaration group prototype MachineFG: type=MachineState
package /DataType/Implementation/CPP
  18 x std cpp implementation data type:
    Arithmetic: compu {0x00=kAdd, 0x01=kSub, 0x02=kMul, 0x03=kDiv}, type-reference=uint8_t
      namespaces:
        symbol props deepracer
        symbol props type
    ByteArray: category=ARRAY, array-size=10, cpp-template-argument=uint8_t
      namespaces:
        symbol props deepracer
        symbol props type
    DistanceMap: category=ASSOCIATIVE_MAP, template-arguments=[Message, double]
      namespaces:
        symbol props deepracer
        symbol props type
    Message: category=STRING
      namespaces:
        symbol props deepracer
        symbol props type
    Speed: type-reference=double
      namespaces:
        symbol props deepracer
        symbol props type
    Uint32Vector: category=VECTOR, cpp-template-argument=uint32_t
      namespaces:
        symbol props deepracer
        symbol props type
    UserRecord: category=STRUCTURE
      namespaces:
        symbol props deepracer
        symbol props type
      cpp implementation data type element id: type-reference=uint32_t
      cpp implementation data type element age: type-reference=uint16_t
      cpp implementation data type element description: type-reference=Message
    bool: category=VALUE, type-emitter=FundamentalType
    double: category=VALUE, type-emitter=FundamentalType
    float: category=VALUE, type-emitter=FundamentalType
    int16_t: category=VALUE, header-file=cstdint
    int32_t: category=VALUE, header-file=cstdint
    int64_t: category=VALUE, header-file=cstdint
    int8_t: category=VALUE, header-file=cstdint
    uint16_t: category=VALUE, header-file=cstdint
    uint32_t: category=VALUE, header-file=cstdint
    uint64_t: category=VALUE, header-file=cstdint
    uint8_t: category=VALUE, header-file=cstdint
package /PortInterface/Service
  service interface SvControlData
    namespaces:
      symbol props deepracer
      symbol props service
      symbol props controldata
    events:
      data CEvent: type=uint32_t
  service interface SvRawData
    namespaces:
      symbol props deepracer
      symbol props service
      symbol props rawdata
    events:
      data REvent: type=uint32_t
    field RField: type=uint32_t, has-getter=true, has-notifier=true, has-setter=true
    methods:
      operation RMethod: fire-and-forget=false
        4 x arg:
          a: type=double, direction=IN
          arithmetic: type=Arithmetic, direction=IN
          b: type=double, direction=IN
          result: type=double, direction=OUT
